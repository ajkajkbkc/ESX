#!armclang --target=arm-arm-none-eabi -mcpu=cortex-m7 -E -x c
/*
** ###################################################################
**     Processors:          MIMXRT1062CVJ5A
**                          MIMXRT1062CVL5A
**                          MIMXRT1062DVJ6A
**                          MIMXRT1062DVL6A
**
**     Compiler:            Keil ARM C/C++ Compiler
**     Reference manual:    IMXRT1060RM Rev.1, 12/2018 | IMXRT1060SRM Rev.3
**     Version:             rev. 0.1, 2017-01-10
**     Build:               b191015
**
**     Abstract:
**         Linker file for the Keil ARM C/C++ Compiler
**
**     Copyright 2016 Freescale Semiconductor, Inc.
**     Copyright 2016-2019 NXP
**     All rights reserved.
**
**     SPDX-License-Identifier: BSD-3-Clause
**
**     http:                 www.nxp.com
**     mail:                 support@nxp.com
**
** ###################################################################
*/
 
#if (defined(__ram_vector_table__))
  #define __ram_vector_table_size__    0x00000800
#else
  #define __ram_vector_table_size__    0x00000000
#endif

#define m_flash_config_start           0x60000000
#define m_flash_config_size            0x00001000

#define m_ivt_start                    0x60001000
#define m_ivt_size                     0x00001000

#define m_interrupts_start             0x60002000
#define m_interrupts_size              0x00000400

#define m_text_start                   0x60002400
#define m_text_size                    0x0007DC00

#define m_interrupts_ram_start         0x20000000
#define m_interrupts_ram_size          __ram_vector_table_size__

/* DTCM, 128K */
#define  m_data_start                  (m_interrupts_ram_start + m_interrupts_ram_size)
#define  m_data_size                   (0x00020000 - m_interrupts_ram_size)

/* OCRAM, 768K */
#define m_data2_start                  0x20200010
#define m_data2_size                   0x000BFFF0

/* ITCM, 128K */
#define m_data3_start                  0x00000000
#define m_data3_size                   0x00020000

#define m_ncache_start                 0x20200000
#define m_ncache_size                  16

/* Sizes */
#if (defined(__stack_size__))
  #define Stack_Size                   __stack_size__
#else
  #define Stack_Size                   1000
#endif

#if (defined(__heap_size__))
  #define Heap_Size                    __heap_size__
#else
  #define Heap_Size                    1024
#endif

#if defined(XIP_BOOT_HEADER_ENABLE) && (XIP_BOOT_HEADER_ENABLE == 1)
LR_m_text m_flash_config_start m_text_start+m_text_size-m_flash_config_start {   ; load region size_region
  RW_m_config_text m_flash_config_start FIXED m_flash_config_size { ; load address = execution address
    * (.boot_hdr.conf, +FIRST)
  }

  RW_m_ivt_text m_ivt_start FIXED m_ivt_size { ; load address = execution address
    * (.boot_hdr.ivt, +FIRST)
    * (.boot_hdr.boot_data)
    * (.boot_hdr.dcd_data)
  }
#else
LR_m_text m_interrupts_start m_text_start+m_text_size-m_interrupts_start {   ; load region size_region
#endif
  VECTOR_ROM m_interrupts_start FIXED m_interrupts_size { ; load address = execution address
    * (.isr_vector,+FIRST)
  }
  ER_m_text m_text_start FIXED m_text_size { ; load address = execution address
    * (InRoot$$Sections)
    .ANY (+RO)
  }

#if (defined(__ram_vector_table__))
  VECTOR_RAM m_interrupts_ram_start EMPTY 0x400 {
  }
#else
  VECTOR_RAM m_interrupts_start EMPTY 0 {
  }
#endif

  /* OCRAM, 768K */
  RW_m_data2 m_data2_start m_data2_size {
    heap_4.o (+RW +ZI)

    /* Necessary to run flash routines from SRAM. And must be put in m_data2 or m_data */
    mflash_drv.o (+RO +RW +ZI)
    bsp_flash.o (+RW +ZI)
    fsl_flexspi.o (+RO +RW +ZI)

    bsp_uart.o (+RW +ZI)
    fsl_lpuart_freertos.o (+RW +ZI)
    fsl_lpuart.o (+RW +ZI)
    serial_manager.o (+RW +ZI)
    serial_port_uart.o (+RW +ZI)
    lpuart_adapter.o (+RW +ZI)
    stream_buffer.o (+RW +ZI)
    ethercatmain.o (+RW +ZI)
    
    mem.o (+RW +ZI)
    memp.o (+RW +ZI)
    bsp_tim.o (+RW +ZI)
    plc_tcpins.o (+RW +ZI)
	kalyke_ping_task.o (+RW +ZI)
	kalyke_internet_task.o (+ZI)
  }

  /* ITCM, 128K */
  RW_m_data3 m_data3_start m_data3_size {
    * (RamFunction)
    bsp_uart.o (+RO)
    fsl_lpuart_freertos.o (+RO)
    fsl_lpuart.o (+RO)
    fsl_str.o (+RO)
    fsl_debug_console.o (+RO)
    serial_manager.o (+RO)
    serial_port_uart.o (+RO)
    lpuart_adapter.o (+RO)
    stream_buffer.o (+RO)

    heap_4.o (+RO)
    port.o (+RO)
    timers.o (+RO)
    tasks.o (+RO)
    queue.o (+RO)
    event_groups.o (+RO)
    list.o (+RO)
    mb_maptable.o (+RO)

    ;When open log, the fowlling files should be commented.
    ;ether_cat_task.o (+RO)
    ;kalyke_internet_task.o (+RO)
    ;mb.o (+RO)
    ;mb_ctrl.o (+RO)
    ;bsp_flash.o (+RO)


    plc_task.o (+RO)
    plc_interrupt.o (+RO)
    plc_variable.o (+RO)
    port_clockcycle.o (+RO)
    plc_commonfunc.o (+RO)
    plc_element.o (+RO)
    plc_complexins.o (+RO)
    plc_counterins.o (+RO)
    plc_executer.o (+RO)
    plc_externalins.o (+RO)
    plc_flowctrlins.o (+RO)
    plc_highspeedins.o (+RO)
    plc_modbusins.o (+RO)
    plc_parseaddr.o (+RO)
    plc_simpleins.o (+RO)
    plc_strins.o (+RO)
    plc_timeins.o (+RO)
    plc_uartins.o (+RO)
    plc_internalmanage.o (+RO)
    plc_password.o (+RO)
    verify_func.o (+RO)

    kalyke_uart_task.o (+RO)
    kalyke_led_task.o (+RO)
    kalyke_tool.o (+RO)
    kalyke_DS1302.o (+RO)
    
    fsl_lpspi.o (+RO)
    fsl_lpspi_freertos.o (+RO)
    fsl_wdog.o (+RO)

    bsp_led.o (+RO)
    bsp_gpio.o (+RO)
    bsp_tim.o (+RO)

    plc_io_interrupt.o (+RO)
    mqtt.o (+RO)
    rand.o (+RO)
    
    nicdrv.o (+RO)
    lw_emac.o (+RO)
    ether_cat_list.o (+RO)
    ethercatbase.o (+RO)
    oshw.o (+RO)
    osal.o (+RO)
    def.o (+RO)

    daisy_uart_task.o (+RO)
    daisy_task.o (+RO)
    ethernet.o (+RO)
    enet_ethernetif_kinetis.o (+RO)
    enet_ethernetif.o (+RO)
    fsl_phy.o (+RO)
    fsl_enet.o (+RO)
    fsl_enet_mdio.o (+RO)
    fsl_cache.o (+RO)
    netifapi.o (+RO)
    netif.o (+RO)
    pbuf.o (+RO)
    memp.o (+RO)
    mem.o (+RO)
    etharp.o (+RO)
    tcpip.o (+RO)
    sys_arch.o (+RO)
    timeouts.o (+RO)
    
    strlen.o (+RO)
    strcpy.o (+RO)
    strncmp.o (+RO)
    strcat.o (+RO)
    memmove.o (+RO)
    memseta.o (+RO)
    strstr.o (+RO)
    strncpy.o (+RO)
    strcmp.o (+RO)
    memcmp.o (+RO)
    __0sscanf.o (+RO)
    printfa.o (+RO)
    memcpy.o (+RO)
    memset.o (+RO)
  }
  
  /* DTCM, 128K */
  RW_m_data m_data_start m_data_size-Stack_Size-Heap_Size { ; RW data
    .ANY (+RW +ZI)
    * (NonCacheable.init)
    * (*NonCacheable)
  }
  
  ARM_LIB_HEAP +0 EMPTY Heap_Size {    ; Heap region growing up
  }
  
  ARM_LIB_STACK m_data_start+m_data_size EMPTY -Stack_Size { ; Stack region growing down
  }
  
  RW_m_ncache m_ncache_start EMPTY 0 {
    
  }
  RW_m_ncache_unused +0 EMPTY m_ncache_size-ImageLength(RW_m_ncache) { ; Empty region added for MPU configuration
  }
  
}
